## SimDocker_res/linux-sim_defconfig
```kconfig
CONFIG_LOW_LEVEL_OPTIONS=y
CONFIG_MACH_LINUX_SIM=y
CONFIG_BOARD_DIRECTORY="linux-sim"
CONFIG_CLOCK_FREQ=50000000
CONFIG_LINUX_SIM_SELECT=y
CONFIG_INITIAL_PINS=""
CONFIG_HAVE_GPIO=y
CONFIG_HAVE_GPIO_ADC=y
CONFIG_HAVE_GPIO_SPI=y
CONFIG_HAVE_GPIO_I2C=y
CONFIG_HAVE_GPIO_HARD_PWM=y
```
